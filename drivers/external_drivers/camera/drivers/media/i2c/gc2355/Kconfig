## drivers/external_drivers/camera/drivers/media/i2c/gc2355/Kconfig
```kconfig
config VIDEO_GC2355
       tristate "gc2355 sensor support"
       default m
       depends on I2C && VIDEO_V4L2
       ---help---
	gc2355 sensor support

config VIDEO_GC2355B
       tristate "gc2355b sensor support"
       default m
       depends on I2C && VIDEO_V4L2
       ---help---
	gc2355b sensor support
```

## drivers/tdlock/Kconfig
```kconfig
#
# TD lock driver configuration
#

config TDLOCK
	bool "Theft Deterrent lock driver"
	depends on TCG_TPM && INTEL_MEI_TXE
	default y
```
